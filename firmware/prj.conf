## CMakeLists.txt
```
cmake_minimum_required(VERSION 3.20.0)
find_package(Zephyr REQUIRED HINTS $ENV{ZEPHYR_BASE})
project(tr66_sp1 LANGUAGES C)

target_include_directories(app PRIVATE ../src)
target_sources(app PRIVATE
    src/main.c
    src/codecs.c
    src/usb_midi.c
    ../src/controls.c
    ../src/midi.c
    ../src/patterns.c
    ../src/sequencer.c
    ../src/tr66.c
)
```

## prj.conf
```kconfig
CONFIG_KERNEL_BIN_NAME="tr66-sp1"
CONFIG_MAIN_STACK_SIZE=4096
CONFIG_SYSTEM_WORKQUEUE_STACK_SIZE=2048
CONFIG_SYSTEM_WORKQUEUE_PRIORITY=2
CONFIG_SPEED_OPTIMIZATIONS=y
CONFIG_FPU=y
CONFIG_ADC=y
CONFIG_ADC_ASYNC=y
CONFIG_I2C=y
CONFIG_I2C_NRFX_TRANSFER_TIMEOUT=100
CONFIG_I2S=y
CONFIG_I2S_NRFX_TX_BLOCK_COUNT=2
CONFIG_PWM=y
CONFIG_POWEROFF=y
CONFIG_REBOOT=y
CONFIG_CONSOLE=y
CONFIG_SERIAL=y
CONFIG_UART_CONSOLE=y
CONFIG_UART_LINE_CTRL=y
CONFIG_USB_DEVICE_STACK_NEXT=y
CONFIG_USBD_MSG_DEFERRED_MODE=n
CONFIG_USBD_CDC_ACM_WORKQUEUE=y
CONFIG_HW_STACK_PROTECTION=y
CONFIG_ASSERT=y
CONFIG_WATCHDOG=y
```

## src/main.c
```c
#include "codecs.h"
#include "controls.h"
#include "usb_midi.h"

#include <soc.h>
#include <nrfx_saadc.h>
#include <string.h>
#include <zephyr/drivers/adc.h>
#include <zephyr/drivers/gpio.h>
#include <zephyr/drivers/i2s.h>
#include <zephyr/drivers/pwm.h>
#include <zephyr/drivers/uart.h>
#include <zephyr/drivers/watchdog.h>
#include <zephyr/kernel.h>
#include <zephyr/sys/atomic.h>
#include <zephyr/sys/poweroff.h>
#include <zephyr/sys/reboot.h>
#include <zephyr/sys/printk.h>

enum {
    RATE = 48000,
    FRAMES = 64,
    BLOCK_BYTES = FRAMES * 2 * sizeof(int16_t),
    QUEUE = CONFIG_I2S_NRFX_TX_BLOCK_COUNT,
    BLOCK_BUDGET = 64000000u * FRAMES / RATE,
    FADER_MAX_RAW = 3701,
    LED_PERIOD = 16000,
    CODEC_START_TIMEOUT_MS = 2500,
    AUDIO_STALL_TIMEOUT_MS = 500,
    FN_PIN = 27,
    BTN_COM_PIN = 10,
    CHARGE_ENABLE_PIN = 21,
    USB_POWER_GOOD_PIN = 24,
};

K_MEM_SLAB_DEFINE_STATIC(audio_blocks, BLOCK_BYTES, QUEUE + 4, 4);
K_MSGQ_DEFINE(input_scans, sizeof(Tr66Input), 8, 4);

static const struct device *const i2s = DEVICE_DT_GET(DT_NODELABEL(i2s0));
static const struct device *const gpio0 = DEVICE_DT_GET(DT_NODELABEL(gpio0));
static const struct device *const gpio1 = DEVICE_DT_GET(DT_NODELABEL(gpio1));
static const struct device *const leds[] = {
    DEVICE_DT_GET(DT_NODELABEL(pwm2)), DEVICE_DT_GET(DT_NODELABEL(pwm3)),
};

#define ANALOG(index) ADC_DT_SPEC_GET_BY_IDX(DT_NODELABEL(zephyr_user), index)
static const struct adc_dt_spec inputs[] = {
    ANALOG(1), ANALOG(2), ANALOG(3), ANALOG(4), ANALOG(5), ANALOG(6),
};

static Tr66Sequencer seq;
static Tr66Controls controls;
static atomic_t codec_status = ATOMIC_INIT(-EINPROGRESS);
static atomic_t led_state;
static atomic_t power_requested;
static atomic_t power_idle;
static uint8_t prior_leds[8];
static float pcm_gain;
static float mono[FRAMES];

/* Inspect over SWD if available. Kept in RAM and accumulated per session. */
volatile struct {
    uint32_t peak_render_cycles, over_budget, write_errors;
    int status;
    unsigned stage, failed_stage, scans, blocks, scan_phase;
    int adc_status;
    int usb_status;
    uint32_t reset_reason;
    unsigned raw[6];
    unsigned adc_timeouts;
    uint32_t adc_enable, adc_end, adc_started, adc_amount;
} tr66_sp1_diagnostics = {.usb_status = -EINPROGRESS};

static __noinit uint32_t fault_key, fault_reason, fault_pc;

void k_sys_fatal_error_handler(unsigned int reason, const struct arch_esf *esf)
{
    fault_reason = reason;
    fault_pc = esf != NULL ? esf->basic.pc : 0;
    fault_key = 0x6631fa17;
    sys_reboot(SYS_REBOOT_COLD);
    CODE_UNREACHABLE;
}

/* The direct Function GPIO must remain usable if audio or ADC stops progressing.
 * A four-second hold is the last-resort reset when orderly shutdown stalls. */
static void power_monitor(void *a, void *b, void *c)
{
    ARG_UNUSED(a); ARG_UNUSED(b); ARG_UNUSED(c);
    int64_t pressed_since = -1;
    bool released = false;
    gpio_pin_configure(gpio0, FN_PIN, GPIO_INPUT | GPIO_PULL_UP);
    for (;;) {
        bool pressed = gpio_pin_get(gpio0, FN_PIN) == 0;
        if (!pressed) {
            released = true;
            pressed_since = -1;
        } else if (released && !atomic_get(&power_idle)) {
            if (pressed_since < 0)
                pressed_since = k_uptime_get();
            int64_t held = k_uptime_get() - pressed_since;
            if (held >= 1800)
                atomic_set(&power_requested, 1);
            if (held >= 4000)
                sys_reboot(SYS_REBOOT_COLD);
        }
        k_msleep(10);
    }
}
K_THREAD_DEFINE(power_thread, 1024, power_monitor, NULL, NULL, NULL, -1, 0, 0);

static void start_usb(void *a, void *b, void *c)
{
    ARG_UNUSED(a); ARG_UNUSED(b); ARG_UNUSED(c);
    tr66_sp1_diagnostics.usb_status = sp1_usb_start();
}
K_THREAD_DEFINE(usb_init_thread, 1536, start_usb, NULL, NULL, NULL, 1, 0, 0);

static void diagnostic_console(void *a, void *b, void *c)
{
    ARG_UNUSED(a); ARG_UNUSED(b); ARG_UNUSED(c);
    const struct device *console = DEVICE_DT_GET(DT_CHOSEN(zephyr_console));
    for (;;) {
        uint32_t dtr = 0;
        if (device_is_ready(console) &&
            uart_line_ctrl_get(console, UART_LINE_CTRL_DTR, &dtr) == 0 && dtr) {
            unsigned char command;
            if (uart_poll_in(console, &command) == 0 && command == 'r')
                sys_reboot(SYS_REBOOT_COLD);
            printk("SP66 t=%u stage=%u failed=%u status=%d scans=%u adc=%d blocks=%u "
                   "peak=%u over=%u errors=%u fn=%d reset=%x fault=%u pc=%x usb=%d "
                   "phase=%u raw=%u,%u,%u,%u,%u,%u timeouts=%u "
                   "saadc=%u,%u,%u,%u\n",
                   k_uptime_get_32(), tr66_sp1_diagnostics.stage,
                   tr66_sp1_diagnostics.failed_stage,
                   tr66_sp1_diagnostics.status, tr66_sp1_diagnostics.scans,
                   tr66_sp1_diagnostics.adc_status, tr66_sp1_diagnostics.blocks,
                   tr66_sp1_diagnostics.peak_render_cycles,
                   tr66_sp1_diagnostics.over_budget, tr66_sp1_diagnostics.write_errors,
                   gpio_pin_get(gpio0, FN_PIN) == 0,
                   tr66_sp1_diagnostics.reset_reason,
                   fault_key == 0x6631fa17 ? fault_reason : 0,
                   fault_key == 0x6631fa17 ? fault_pc : 0,
                   tr66_sp1_diagnostics.usb_status,
                   tr66_sp1_diagnostics.scan_phase,
                   tr66_sp1_diagnostics.raw[0], tr66_sp1_diagnostics.raw[1],
                   tr66_sp1_diagnostics.raw[2], tr66_sp1_diagnostics.raw[3],
                   tr66_sp1_diagnostics.raw[4], tr66_sp1_diagnostics.raw[5],
                   tr66_sp1_diagnostics.adc_timeouts,
                   tr66_sp1_diagnostics.adc_enable, tr66_sp1_diagnostics.adc_end,
                   tr66_sp1_diagnostics.adc_started, tr66_sp1_diagnostics.adc_amount);
        }
        k_msleep(1000);
    }
}
K_THREAD_DEFINE(console_thread, 1536, diagnostic_console, NULL, NULL, NULL, 1, 0, 1000);

static const float volume_gains[] = {
    0.0f, 0.00794f, 0.01122f, 0.01585f, 0.02239f, 0.03162f, 0.04467f, 0.06310f,
    0.08913f, 0.12589f, 0.17783f, 0.25119f, 0.35481f, 0.50119f, 0.70795f, 1.0f,
};

static enum Tr66ControlKey decode_ladder(unsigned raw, const unsigned *centers,
                                        unsigned count, enum Tr66ControlKey first)
{
    if (raw < 85)
        return TR66_KEY_NONE;
    for (unsigned i = 0; i < count; ++i) {
        if (raw + 25 >= centers[i] && raw <= centers[i] + 25)
            return first + i;
    }
    return TR66_KEY_INVALID;
}

static int read_analog(const struct adc_dt_spec *spec, int16_t *value)
{
    struct adc_sequence sample = {.buffer = value, .buffer_size = sizeof(*value)};
    int rc = adc_sequence_init_dt(spec, &sample);
    if (rc != 0)
        return rc;
    sample.oversampling = 1;
    struct k_poll_signal done;
    k_poll_signal_init(&done);
    struct k_poll_event event = K_POLL_EVENT_INITIALIZER(
        K_POLL_TYPE_SIGNAL, K_POLL_MODE_NOTIFY_ONLY, &done);
    rc = adc_read_async(spec->dev, &sample, &done);
    if (rc != 0)
        return rc;
    if (k_poll(&event, 1, K_MSEC(10)) == 0)
        return done.result;

    ++tr66_sp1_diagnostics.adc_timeouts;
    /* A timed-out request still owns the sample buffer and the driver's lock.
     * Stop it, then await its completion before either can be reused. */
    unsigned key = irq_lock();
    tr66_sp1_diagnostics.adc_enable = NRF_SAADC->ENABLE;
    tr66_sp1_diagnostics.adc_end = NRF_SAADC->EVENTS_END;
    tr66_sp1_diagnostics.adc_started = NRF_SAADC->EVENTS_STARTED;
    tr66_sp1_diagnostics.adc_amount = NRF_SAADC->RESULT.AMOUNT;
    if (!done.signaled)
        nrfx_saadc_abort();
    irq_unlock(key);
    event.state = K_POLL_STATE_NOT_READY;
    if (k_poll(&event, 1, K_MSEC(10)) != 0) {
        /* Do not leave DMA pointing into a returned stack frame. */
        sys_reboot(SYS_REBOOT_COLD);
        CODE_UNREACHABLE;
    }
    return -ETIMEDOUT;
}

static bool read_input(Tr66Input *input)
{
    unsigned raw[ARRAY_SIZE(inputs)];
    for (unsigned i = 0; i < ARRAY_SIZE(inputs); ++i) {
        tr66_sp1_diagnostics.scan_phase = 10 + i;
        int16_t value = 0;
        int rc = read_analog(&inputs[i], &value);
        tr66_sp1_diagnostics.adc_status = rc;
        if (rc != 0)
            return false;
        raw[i] = value > 0 ? value : 0;
        tr66_sp1_diagnostics.raw[i] = raw[i];
    }
    tr66_sp1_diagnostics.scan_phase = 20;
    static const unsigned track[] = {210, 399, 728, 1215, 1813};
    static const unsigned side[] = {403, 1216, 729, 1817};
    input->track = decode_ladder(raw[0], track, ARRAY_SIZE(track), TR66_KEY_T1);
    input->side = decode_ladder(raw[1], side, ARRAY_SIZE(side), TR66_KEY_A);
    input->fn = gpio_pin_get(gpio0, FN_PIN) == 0;
    for (unsigned i = 0; i < ARRAY_SIZE(input->fader); ++i)
        input->fader[i] = MIN(raw[2 + i], FADER_MAX_RAW) * 4095 / FADER_MAX_RAW;
    return true;
}

static void set_leds(unsigned mask)
{
    for (unsigned i = 0; i < ARRAY_SIZE(prior_leds); ++i) {
        uint8_t level = (mask >> (2 * i)) & 3u;
        if (level != prior_leds[i] && device_is_ready(leds[i / 4])) {
            tr66_sp1_diagnostics.scan_phase = 30 + i;
            static const unsigned pulse[] = {0, LED_PERIOD / 100, LED_PERIOD / 18, LED_PERIOD / 4};
            unsigned channel = i < 4 ? i : 7 - i;
            pwm_set_cycles(leds[i / 4], channel, LED_PERIOD, pulse[level], 0);
            prior_leds[i] = level;
        }
    }
    tr66_sp1_diagnostics.scan_phase = 40;
}

static void publish_leds(void)
{
    unsigned state = 3u << (controls.bank * 2);
    /* Show the pin for the rhythm under Fader 3 while Function is held. */
    bool t4_lit = controls.fn_scans > 0 ?
                  (controls.pinned_rhythms & TR66_RHYTHM_BIT(controls.request.rhythm)) != 0 :
                  controls.variation_enabled;
    if (t4_lit)
        state |= 3u << 6;
    if (controls.unavailable && (k_uptime_get_32() % 500 < 250))
        state &= ~(3u << (controls.bank * 2));

    unsigned bars = 0x0f;
    if (controls.request.arrange == TR66_ARRANGE_A)
        bars = 0x03;
    if (controls.request.arrange == TR66_ARRANGE_B)
        bars = 0x0c;
    for (unsigned i = 0; i < 4; ++i) {
        if (bars & BIT(i))
            state |= 1u << (8 + 2 * i);
    }
    if (seq.running) {
        unsigned bar = seq.bar;
        if (seq.selection.arrange == TR66_ARRANGE_A)
            bar %= 2;
        if (seq.selection.arrange == TR66_ARRANGE_B)
            bar = 2 + bar % 2;
        if (seq.fill)
            bar = 3;
        unsigned shift = 8 + 2 * bar;
        state &= ~(3u << shift);
        state |= (seq.tick < 4 ? 3u : 2u) << shift;
    }
    atomic_set(&led_state, state);
}

static void scan_controls(struct k_work *work)
{
    ++tr66_sp1_diagnostics.scans;
    tr66_sp1_diagnostics.scan_phase = 1;
    static Tr66Input held;
    static unsigned ladder_idle;
    Tr66Input input = {0};
    if (read_input(&input)) {
        /* The ladder loads the fader rail. Freeze positions through a press
         * and its short settling period. Keep the raw button states. */
        if (input.track != TR66_KEY_NONE || input.side != TR66_KEY_NONE)
            ladder_idle = 0;
        else if (ladder_idle < 3)
            ++ladder_idle;
        if (ladder_idle == 3)
            held = input;
        else
            memcpy(input.fader, held.fader, sizeof(input.fader));
        k_msgq_put(&input_scans, &input, K_NO_WAIT);
    }
    set_leds(atomic_get(&led_state));
    static unsigned jack_count;
    if (++jack_count == 4) {
        tr66_sp1_diagnostics.scan_phase = 50;
        sp1_codecs_poll_jack();
        jack_count = 0;
    }
    tr66_sp1_diagnostics.scan_phase = 60;
    k_work_schedule(k_work_delayable_from_work(work), K_MSEC(10));
    tr66_sp1_diagnostics.scan_phase = 61;
}
K_WORK_DELAYABLE_DEFINE(scan_work, scan_controls);

static void start_codecs(struct k_work *work)
{
    ARG_UNUSED(work);
    atomic_set(&codec_status, sp1_codecs_start());
}
K_WORK_DEFINE(codec_start_work, start_codecs);

static int begin_stream(void)
{
    const struct i2s_config config = {
        .word_size = 16, .channels = 2,
        .format = I2S_FMT_DATA_FORMAT_I2S,
        .options = I2S_OPT_FRAME_CLK_SLAVE | I2S_OPT_BIT_CLK_SLAVE,
        .frame_clk_freq = RATE, .block_size = BLOCK_BYTES, .mem_slab = &audio_blocks,
        .timeout = 100,
    };
    int rc = i2s_configure(i2s, I2S_DIR_TX, &config);
    if (rc != 0)
        return rc;
    for (unsigned i = 0; i < QUEUE; ++i) {
        void *data;
        rc = k_mem_slab_alloc(&audio_blocks, &data, K_NO_WAIT);
        if (rc != 0)
            return rc;
        memset(data, 0, BLOCK_BYTES);
        rc = i2s_write(i2s, data, BLOCK_BYTES);
        if (rc != 0) {
            k_mem_slab_free(&audio_blocks, data);
            return rc;
        }
    }
    return i2s_trigger(i2s, I2S_DIR_TX, I2S_TRIGGER_START);
}

static void fill_audio(int16_t *stereo)
{
    float target = tr66_line_gain * volume_gains[controls.volume];
    tr66_seq_render(&seq, mono, FRAMES);
    for (unsigned i = 0; i < FRAMES; ++i) {
        pcm_gain += 0.0026f * (target - pcm_gain);
        float value = CLAMP(mono[i] * pcm_gain, -1.0f, 1.0f);
        int16_t pcm = (int16_t)(value * 32767.0f);
        stereo[2 * i] = pcm;
        stereo[2 * i + 1] = pcm;
    }
}

static int init_controls(void)
{
    if (!device_is_ready(gpio0) || !device_is_ready(gpio1))
        return -ENODEV;
    memset(prior_leds, 0xff, sizeof(prior_leds));
    for (unsigned i = 0; i < ARRAY_SIZE(leds); ++i) {
        int rc = device_init(leds[i]);
        if (rc != 0 && rc != -EALREADY)
            return rc;
    }
    set_leds(3u << 8); /* Light the LED nearest Function while starting. */

    int rc = gpio_pin_configure(gpio0, FN_PIN, GPIO_INPUT | GPIO_PULL_UP);
    if (rc == 0)
        rc = gpio_pin_configure(gpio1, BTN_COM_PIN, GPIO_OUTPUT_HIGH);
    if (rc != 0)
        return rc;
    for (unsigned i = 0; i < ARRAY_SIZE(inputs); ++i) {
        if (!adc_is_ready_dt(&inputs[i]))
            return -ENODEV;
        rc = adc_channel_setup_dt(&inputs[i]);
        if (rc != 0)
            return rc;
    }
    return 0;
}

static int run_audio(void)
{
    bool codecs_ready = false;
    const int64_t codec_deadline = k_uptime_get() + CODEC_START_TIMEOUT_MS;
    int64_t last_write = 0;
    while (!atomic_get(&power_requested)) {
        sp1_feed_watchdog();
        const int64_t now = k_uptime_get();
        if (!codecs_ready) {
            int status = atomic_get(&codec_status);
            if (status == 0) {
                codecs_ready = true;
                last_write = now;
                tr66_sp1_diagnostics.stage = 5;
                tr66_sp1_diagnostics.status = 0;
                k_work_schedule(&scan_work, K_NO_WAIT);
            } else if (status != -EINPROGRESS) {
                return status;
            } else if (now >= codec_deadline) {
                return -ETIMEDOUT;
            }
        } else if (now - last_write >= AUDIO_STALL_TIMEOUT_MS) {
            return -ETIMEDOUT;
        }

        bool shutdown = false;
        /* Expire a disconnected clock before Play chooses its clock source. */
        sp1_midi_poll(&seq, controls.initialized);
        Tr66Input input;
        while (k_msgq_get(&input_scans, &input, K_NO_WAIT) == 0)
            shutdown |= tr66_controls_scan(&controls, &seq, input);
        if (shutdown)
            break;

        void *data;
        if (k_mem_slab_alloc(&audio_blocks, &data, K_MSEC(100)) != 0)
            continue;
        uint32_t start = DWT->CYCCNT;
        fill_audio(data);
        uint32_t cycles = DWT->CYCCNT - start;
        tr66_sp1_diagnostics.peak_render_cycles =
            MAX(tr66_sp1_diagnostics.peak_render_cycles, cycles);
        tr66_sp1_diagnostics.over_budget += cycles > BLOCK_BUDGET;

        int rc = i2s_write(i2s, data, BLOCK_BYTES);
        if (rc == 0) {
            ++tr66_sp1_diagnostics.blocks;
            last_write = k_uptime_get();
            if (codecs_ready)
                publish_leds();
            continue;
        }
        k_mem_slab_free(&audio_blocks, data);
        /* A full TX queue is expected until the headphone codec supplies
         * LRCK. Dropping the stream here may leave it waiting for STOPPED. */
        if (rc != -EAGAIN || codecs_ready)
            ++tr66_sp1_diagnostics.write_errors;
        if (rc == -EAGAIN)
            continue;
        if (!codecs_ready) {
            k_msleep(5); /* Let codec work finish before trying to restart TX. */
            continue;
        }

        i2s_trigger(i2s, I2S_DIR_TX, I2S_TRIGGER_DROP);
        k_msleep(5);
        rc = begin_stream();
        if (rc != 0)
            return rc;
    }
    return 0;
}

static void idle_until_wake(void)
{
    atomic_set(&power_idle, 1);
    tr66_sp1_diagnostics.stage = 9;
    /* Wait for release so GPIO level sensing will see the next press. */
    while (gpio_pin_get(gpio0, FN_PIN) == 0) {
        sp1_feed_watchdog();
        k_msleep(20);
    }
    k_msleep(60);
    gpio_pin_set(gpio1, BTN_COM_PIN, 0);
    gpio_pin_configure(gpio0, USB_POWER_GOOD_PIN, GPIO_INPUT | GPIO_PULL_UP);
    while ((NRF_POWER->USBREGSTATUS & POWER_USBREGSTATUS_VBUSDETECT_Msk) ||
           gpio_pin_get(gpio0, USB_POWER_GOOD_PIN) == 0) {
        if (gpio_pin_get(gpio0, FN_PIN) == 0)
            sys_reboot(SYS_REBOOT_COLD);
        sp1_feed_watchdog();
        k_msleep(20);
    }
    NRF_P0->PIN_CNF[FN_PIN] |= GPIO_PIN_CNF_SENSE_Low << GPIO_PIN_CNF_SENSE_Pos;
    sp1_feed_watchdog();
    NRF_POWER->RESETREAS = 0xffffffff;
    sys_poweroff();
}

int main(void)
{
    tr66_sp1_diagnostics.reset_reason = NRF_POWER->RESETREAS;
    NRF_POWER->RESETREAS = 0xffffffff;
    sp1_feed_watchdog();
    const struct device *watchdog = DEVICE_DT_GET(DT_ALIAS(watchdog0));
    if (device_is_ready(watchdog)) {
        const struct wdt_timeout_cfg timeout = {
            .window.max = 4000, .flags = WDT_FLAG_RESET_SOC,
        };
        /* An already-running bootloader watchdog cannot be reconfigured.
         * The existing feed helper reloads every channel in either case. */
        if (wdt_install_timeout(watchdog, &timeout) >= 0)
            wdt_setup(watchdog, 0);
    }
    tr66_sp1_diagnostics.stage = 1;
    tr66_seq_init(&seq, RATE, UINT32_C(14293));
    tr66_controls_init(&controls);
    DCB->DEMCR |= DCB_DEMCR_TRCENA_Msk;
    DWT->CTRL |= DWT_CTRL_CYCCNTENA_Msk;

    tr66_sp1_diagnostics.stage = 2;
    int rc = gpio_pin_configure(gpio0, CHARGE_ENABLE_PIN, GPIO_OUTPUT_LOW);
    if (rc == 0)
        rc = init_controls();
    if (rc == 0) {
        tr66_sp1_diagnostics.stage = 3;
        rc = gpio_pin_set(gpio0, CHARGE_ENABLE_PIN, 1); /* disable charging while playing */
    }
    if (rc == 0 && device_is_ready(i2s))
        rc = sp1_codecs_power_on();
    else if (rc == 0)
        rc = -ENODEV;
    if (rc == 0)
        rc = begin_stream();

    bool codec_work_started = false;
    if (rc == 0) {
        tr66_sp1_diagnostics.stage = 4;
        /* The codec starts the frame clock before its setup finishes.
         * Keep supplying silence while setup runs on the work queue. */
        rc = k_work_submit(&codec_start_work);
        if (rc >= 0) {
            codec_work_started = true;
            tr66_sp1_diagnostics.status = -EINPROGRESS;
            rc = run_audio();
        }
    }
    tr66_sp1_diagnostics.status = rc;
    if (rc != 0)
        tr66_sp1_diagnostics.failed_stage = tr66_sp1_diagnostics.stage;
    if (codec_work_started) {
        tr66_sp1_diagnostics.stage = 6;
        struct k_work_sync sync;
        k_work_cancel_sync(&codec_start_work, &sync);
        k_work_cancel_delayable_sync(&scan_work, &sync);
    }

    if (device_is_ready(i2s))
        i2s_trigger(i2s, I2S_DIR_TX, I2S_TRIGGER_DROP);
    k_msleep(5);
    /* An I2S slave may never see STOPPED if the frame clock disappeared.
     * Disable the peripheral before parking the codec and its clocks. */
    NRF_I2S->ENABLE = I2S_ENABLE_ENABLE_Disabled;
    gpio_pin_configure(gpio0, 12, GPIO_DISCONNECTED); /* BCLK */
    gpio_pin_configure(gpio0, 11, GPIO_DISCONNECTED); /* LRCK */
    gpio_pin_configure(gpio1, 9, GPIO_DISCONNECTED);  /* SDOUT */
    sp1_codecs_power_off();
    gpio_pin_configure(gpio0, CHARGE_ENABLE_PIN, GPIO_OUTPUT_LOW);
    if (rc != 0) {
        tr66_sp1_diagnostics.stage = 8;
        while (!atomic_get(&power_requested)) {
            set_leds(k_uptime_get_32() % 500 < 250 ? 0xff00u : 0);
            sp1_feed_watchdog();
            k_msleep(50);
        }
    }
    set_leds(0);
    idle_until_wake();
    return rc;
}
```

## src/codecs.c
```c
/* SP-1 codec sequences from Wakes and sp1-tape-looper (MIT).
 * See firmware/NOTICE for the original pin and register sources. */
#include "codecs.h"

#include <soc.h>
#include <zephyr/drivers/gpio.h>
#include <zephyr/drivers/i2c.h>
#include <zephyr/kernel.h>

#define TAS2505_ADDR 0x18u
#define CS42L42_ADDR 0x48u
#define SPEAKER_TRIM_HALF_DB (-18)

static const struct device *const i2c_bus = DEVICE_DT_GET(DT_NODELABEL(i2c0));
static const struct device *const gpio = DEVICE_DT_GET(DT_NODELABEL(gpio0));
static bool speaker_on;
static bool last_wanted;
static unsigned stable_reads;

void sp1_feed_watchdog(void)
{
    /* The bootloader may have armed channels before entering the app. */
    for (unsigned ch = 0; ch < 8; ++ch)
        NRF_WDT->RR[ch] = WDT_RR_RR_Reload;
}

static int tas_wr(uint8_t reg, uint8_t val)
{
	sp1_feed_watchdog();
	return i2c_reg_write_byte(i2c_bus, TAS2505_ADDR, reg, val);
}

#define TAS_W(reg, val) do { if (tas_wr((reg), (val)) != 0) { return false; } } while (0)

static bool tas2505_configure(void)
{

	TAS_W(0x00, 0x00);          /* page 0 */
	TAS_W(0x01, 0x01);          /* software reset */
	k_msleep(5);

	TAS_W(0x00, 0x01);          /* page 1 */
	TAS_W(0x02, 0x00);          /* LDO 1.8 V, level shifters up */

	TAS_W(0x00, 0x00);          /* page 0: clocking + interface */
	TAS_W(0x04, 0x07);          /* PLL_CLKIN = BCLK, CODEC_CLKIN = PLL */
	TAS_W(0x05, 0x91);          /* PLL powered, P=1, R=1 */
	TAS_W(0x06, 0x20);          /* PLL J = 32 -> 98.304 MHz */
	TAS_W(0x07, 0x00);          /* PLL D MSB */
	TAS_W(0x08, 0x00);          /* PLL D LSB */
	k_msleep(15);                      /* PLL lock */
	TAS_W(0x0B, 0x82);          /* NDAC = 2, powered */
	TAS_W(0x0C, 0x88);          /* MDAC = 8, powered */
	TAS_W(0x0D, 0x00);          /* DOSR MSB */
	TAS_W(0x0E, 0x80);          /* DOSR = 128 -> 48 000 Hz */
	TAS_W(0x1B, 0x00);          /* I2S, 16-bit, slave */
	TAS_W(0x1C, 0x00);          /* data slot offset 0 */
	TAS_W(0x3C, 0x02);          /* DAC processing block PRB_P2 (mono) */
	TAS_W(0x3F, 0x90);          /* DAC powered, left -> left, soft-step */
	TAS_W(0x41, (uint8_t)(int8_t)SPEAKER_TRIM_HALF_DB);  /* speaker-only trim */
	TAS_W(0x40, 0x04);          /* DAC unmuted */

	TAS_W(0x00, 0x01);          /* page 1: analog, routing, driver */
	TAS_W(0x01, 0x10);          /* master analog reference on */
	TAS_W(0x0A, 0x00);          /* output common mode 0.9 V */
	TAS_W(0x0C, 0x04);          /* DAC -> output mixer */
	TAS_W(0x16, 0x00);          /* HP volume 0 dB */
	TAS_W(0x18, 0x00);          /* AINL volume / mixer */
	TAS_W(0x09, 0x20);          /* HP driver up */
	TAS_W(0x10, 0x00);          /* HP unmuted */
	TAS_W(0x2E, 0x00);          /* speaker attenuation 0 dB */
	TAS_W(0x30, 0x30);          /* class-D gain +18 dB (tape-looper's value) */
	TAS_W(0x2D, 0x00);          /* wait for jack detection before enabling speaker */

	TAS_W(0x00, 0x00);          /* back to page 0 */
	k_msleep(10);

	return true;
}

/* ============================================================================
 *  CS42L42 headphone codec, and FRAME-CLOCK MASTER -- VERBATIM from sp1-tape-looper's
 *  live path (HP_TIM_TEST 1), which is Tim Knapen's SP-1-dev wiki sequence.
 *
 *  ⚠️ tape-looper's own comments above that code describe an OLDER design with the
 *  oscillator OFF and the nRF as master. That path is dead code there. This is the
 *  live one: oscillator ON, CS42L42 mastering the frame. Do not port the stale comment.
 * ========================================================================== */
static bool cs_pw(uint16_t reg, uint8_t val)   /* paged write */
{
	sp1_feed_watchdog();                                /* see the note above tas_wr */
	const uint8_t p[2] = { 0x00, (uint8_t)(reg >> 8) };
	const uint8_t b[2] = { (uint8_t)reg, val };
	if (i2c_write(i2c_bus, p, 2, CS42L42_ADDR) != 0) {
		return false;
	}
	return i2c_write(i2c_bus, b, 2, CS42L42_ADDR) == 0;
}

static bool cs_pr(uint16_t reg, uint8_t *val)  /* paged read */
{
	sp1_feed_watchdog();
	const uint8_t p[2] = { 0x00, (uint8_t)(reg >> 8) };
	const uint8_t o = (uint8_t)reg;
	if (i2c_write(i2c_bus, p, 2, CS42L42_ADDR) != 0) {
		return false;
	}
	return i2c_write_read(i2c_bus, CS42L42_ADDR, &o, 1, val, 1) == 0;
}

#define CS_W(reg, val) do { if (!cs_pw((reg), (val))) { return false; } } while (0)

static bool cs42l42_configure(void)
{
	/* Hard reset pulse -- without it the codec can be wedged and NAK everything. */
	gpio_pin_set(gpio, 15, 0);
	k_msleep(5);
	gpio_pin_set(gpio, 15, 1);
	k_msleep(10);

	uint8_t id = 0;
	if (!cs_pr(0x1001, &id) || id != 0x42) {
		return false;                      /* not a CS42L42: leave it alone */
	}

	CS_W(0x1508, 0x10);   /* PLL Control 3 */
	CS_W(0x1504, 0x80);   /* PLL Division Fractional Byte 2 */
	CS_W(0x1505, 0x3E);   /* PLL Division Integer */
	CS_W(0x150A, 0x7D);   /* PLL Calibration Ratio */
	CS_W(0x1009, 0x00);   /* MCLK Control */
	CS_W(0x1201, 0x01);   /* MCLK Source Select */
	CS_W(0x120A, 0x01);   /* Input ASRC Clock Select */
	CS_W(0x120B, 0x01);   /* Output ASRC Clock Select */
	CS_W(0x1501, 0x01);   /* PLL Control 1: start */
	CS_W(0x1107, 0x01);   /* Oscillator Switch (the 3.072 MHz osc drives SCLK) */
	for (int t = 0; t < 10; t++) {         /* wait for "SCLK selected" (0x02) */
		uint8_t s = 0;
		k_msleep(1);
		if (cs_pr(0x1109, &s) && s == 0x02) {
			break;
		}
	}
	CS_W(0x1007, 0x13);   /* Serial Port SRC Control */
	CS_W(0x1203, 0x1F);   /* FSYNC Pulse Width Lower (64-SCLK frame) */
	CS_W(0x1205, 0x3F);   /* FSYNC Period Lower */
	CS_W(0x1207, 0x34);   /* ASP Clock Config: MASTER */
	CS_W(0x1208, 0x1A);   /* ASP Frame Configuration */
	CS_W(0x2A02, 0x02);   /* Channel 1: 24-bit */
	CS_W(0x2A05, 0x42);   /* Channel 2: phase + 24-bit */
	CS_W(0x2601, 0x4C);   /* SRC Input Sample Rate */
	CS_W(0x2609, 0x4C);   /* SRC Output Sample Rate */
	CS_W(0x2A01, 0x0C);   /* ASP Receive Enable */
	CS_W(0x240E, 0x01);   /* Equalizer Input Mute Control */
	CS_W(0x2301, 0x00);   /* Mixer A vol 0 dB */
	CS_W(0x2303, 0x00);   /* Mixer B vol */
	CS_W(0x1101, 0x96);   /* power up the codec */
	k_msleep(10);                /* HP amp operational after 10 ms */
	CS_W(0x1121, 0x41);   /* Headset switch control */
	CS_W(0x1B74, 0x03);   /* Miscellaneous detect control */
	CS_W(0x1129, 0x01);   /* Headset clamp disable */
	CS_W(0x2001, 0x0D);   /* HP Control: mute all */
	CS_W(0x1F06, 0x84);   /* DAC Control 2 */
	CS_W(0x2301, 0x00);   /* Mixer A vol again */
	CS_W(0x2303, 0x00);   /* Mixer B vol again */
	CS_W(0x1B73, 0xC2);   /* Tip Sense Control */
	CS_W(0x1B75, 0x9F);   /* Mic detect control 1 */
	CS_W(0x2001, 0x01);   /* UNMUTE headphones */
	return true;
}


int sp1_codecs_power_on(void)
{
    if (!device_is_ready(i2c_bus) || !device_is_ready(gpio))
        return -ENODEV;
    int rc = gpio_pin_configure(gpio, 9, GPIO_OUTPUT_HIGH);
    if (rc == 0)
        rc = gpio_pin_configure(gpio, 15, GPIO_OUTPUT_HIGH);
    if (rc == 0)
        rc = gpio_pin_configure(gpio, 13, GPIO_OUTPUT_HIGH);
    k_msleep(25);
    return rc;
}

int sp1_codecs_start(void)
{
    speaker_on = false;
    stable_reads = 0;
    /* BCLK exists now. Start the amp's PLL, then the frame clock master. */
    if (!tas2505_configure() || !cs42l42_configure())
        return -EIO;
    return 0;
}

void sp1_codecs_power_off(void)
{
    gpio_pin_configure(gpio, 9, GPIO_OUTPUT_LOW);
    gpio_pin_configure(gpio, 15, GPIO_OUTPUT_LOW);
    gpio_pin_configure(gpio, 13, GPIO_OUTPUT_LOW);
}

void sp1_codecs_poll_jack(void)
{
    uint8_t status;
    if (!cs_pr(0x1B77, &status)) {
        stable_reads = 0;
        return;
    }
    bool want_speaker = (status & 0x80u) == 0;
    if (want_speaker != last_wanted) {
        last_wanted = want_speaker;
        stable_reads = 0;
    }
    if (stable_reads < 3)
        ++stable_reads;
    if (stable_reads == 3 && want_speaker != speaker_on) {
        if (tas_wr(0x00, 0x01) == 0 && tas_wr(0x2D, want_speaker ? 0x02 : 0x00) == 0)
            speaker_on = want_speaker;
        tas_wr(0x00, 0x00);
    }
}
```

## src/codecs.h
```c
#ifndef TR66_CODECS_H
#define TR66_CODECS_H

#include <stdbool.h>

void sp1_feed_watchdog(void);
int sp1_codecs_power_on(void);
int sp1_codecs_start(void);
void sp1_codecs_power_off(void);
void sp1_codecs_poll_jack(void);

#endif
```

## src/usb_midi.c
```c
/* SPDX-License-Identifier: MIT */
/* USB-MIDI 1.0 descriptors adapted from feldd, Copyright (c) 2026 Benjamin Reece. */
#include "usb_midi.h"

#include <zephyr/drivers/usb/udc.h>
#include <zephyr/kernel.h>
#include <zephyr/usb/usbd.h>

enum {
    MIDI_MPS = 64,
    QUEUE_DEPTH = 32,
    EXT_IN_JACK = 1, EMBEDDED_OUT_JACK = 2,
    EMBEDDED_IN_JACK = 3, EXT_OUT_JACK = 4,
};

typedef struct {
    Tr66MidiEvent event;
    uint32_t received_ms;
} ReceivedMidi;

K_MSGQ_DEFINE(midi_events, sizeof(ReceivedMidi), QUEUE_DEPTH, 4);
UDC_BUF_POOL_DEFINE(midi_rx_pool, 1, MIDI_MPS, sizeof(struct udc_buf_info), NULL);

/* AudioControl names the MIDIStreaming interface. Keep the two interfaces
 * grouped via the class header, as in Wakes/feldd, with both bulk directions. */
static struct usb_if_descriptor audio_control = {
    .bLength = sizeof(audio_control),
    .bDescriptorType = USB_DESC_INTERFACE,
    .bInterfaceClass = USB_BCC_AUDIO,
    .bInterfaceSubClass = 0x01,
};
static uint8_t audio_header[] = {9, USB_DESC_CS_INTERFACE, 1, 0, 1, 9, 0, 1, 0};
static struct usb_if_descriptor midi_streaming = {
    .bLength = sizeof(midi_streaming),
    .bDescriptorType = USB_DESC_INTERFACE,
    .bNumEndpoints = 2,
    .bInterfaceClass = USB_BCC_AUDIO,
    .bInterfaceSubClass = 0x03,
};
static const uint8_t external_in[] = {6, USB_DESC_CS_INTERFACE, 2, 2, EXT_IN_JACK, 0};
static const uint8_t embedded_out[] = {
    9, USB_DESC_CS_INTERFACE, 3, 1, EMBEDDED_OUT_JACK, 1, EXT_IN_JACK, 1, 0,
};
static const uint8_t embedded_in[] = {6, USB_DESC_CS_INTERFACE, 2, 1, EMBEDDED_IN_JACK, 0};
static const uint8_t external_out[] = {
    9, USB_DESC_CS_INTERFACE, 3, 2, EXT_OUT_JACK, 1, EMBEDDED_IN_JACK, 1, 0,
};
static const uint8_t midi_header[] = {
    7, USB_DESC_CS_INTERFACE, 1, 0, 1,
    7 + sizeof(external_in) + sizeof(embedded_out) + sizeof(embedded_in) + sizeof(external_out),
    0,
};
/* MIDI 1.0 bulk endpoint descriptors have two trailing audio fields.
 * Zephyr assigns the addresses at init. */
struct midi_endpoint {
    struct usb_ep_descriptor usb;
    uint8_t refresh, synch_address;
} __packed;
static struct midi_endpoint midi_out_ep = {
    .usb = {
        .bLength = sizeof(midi_out_ep), .bDescriptorType = USB_DESC_ENDPOINT,
        .bEndpointAddress = 0x01, .bmAttributes = USB_EP_TYPE_BULK,
        .wMaxPacketSize = sys_cpu_to_le16(MIDI_MPS),
    },
};
static struct midi_endpoint midi_in_ep = {
    .usb = {
        .bLength = sizeof(midi_in_ep), .bDescriptorType = USB_DESC_ENDPOINT,
        .bEndpointAddress = 0x81, .bmAttributes = USB_EP_TYPE_BULK,
        .wMaxPacketSize = sys_cpu_to_le16(MIDI_MPS),
    },
};
static const uint8_t midi_out_jack[] = {5, USB_DESC_CS_ENDPOINT, 1, 1, EMBEDDED_IN_JACK};
static const uint8_t midi_in_jack[] = {5, USB_DESC_CS_ENDPOINT, 1, 1, EMBEDDED_OUT_JACK};

#define DESC(item) ((const struct usb_desc_header *)&(item))
static const struct usb_desc_header *midi_descriptors[] = {
    DESC(audio_control), DESC(audio_header), DESC(midi_streaming), DESC(midi_header),
    DESC(external_in), DESC(embedded_out), DESC(embedded_in), DESC(external_out),
    DESC(midi_out_ep), DESC(midi_out_jack), DESC(midi_in_ep), DESC(midi_in_jack),
    NULL,
};
#undef DESC

/* Only the USB stack thread writes the queue and owns the endpoint state. */
static bool receiving, rx_pending;

static void reset_midi_queue(void)
{
    /* An empty event tells the audio thread to discard the old transport.
     * Preserve ordering with any packets arriving after a reset/overflow. */
    k_msgq_purge(&midi_events);
    const ReceivedMidi reset = {0};
    k_msgq_put(&midi_events, &reset, K_NO_WAIT);
}

static void arm_rx(struct usbd_class_data *class_data)
{
    if (!receiving || rx_pending)
        return;
    struct net_buf *buffer = net_buf_alloc(&midi_rx_pool, K_NO_WAIT);
    if (buffer == NULL)
        return;
    udc_get_buf_info(buffer)->ep = midi_out_ep.usb.bEndpointAddress;
    rx_pending = usbd_ep_enqueue(class_data, buffer) == 0;
    if (!rx_pending)
        net_buf_unref(buffer);
}

static int midi_request(struct usbd_class_data *class_data, struct net_buf *buffer, int error)
{
    rx_pending = false;
    if (error == 0 && receiving) {
        const uint32_t now = k_uptime_get_32();
        for (size_t offset = 0; offset + 4 <= buffer->len; offset += 4) {
            ReceivedMidi message = {tr66_midi_usb_event(buffer->data + offset), now};
            if (message.event.status != TR66_MIDI_NONE &&
                k_msgq_put(&midi_events, &message, K_NO_WAIT) != 0) {
                reset_midi_queue();
                break;
            }
        }
    }
    net_buf_unref(buffer);
    arm_rx(class_data);
    return 0;
}

static void midi_enable(struct usbd_class_data *class_data)
{
    receiving = true;
    arm_rx(class_data);
}

static void midi_disable(struct usbd_class_data *class_data)
{
    ARG_UNUSED(class_data);
    receiving = false;
    reset_midi_queue();
}

static void midi_halt(struct usbd_class_data *class_data, uint8_t endpoint, bool halted)
{
    if (endpoint == midi_out_ep.usb.bEndpointAddress && !halted)
        arm_rx(class_data);
}

static int midi_init(struct usbd_class_data *class_data)
{
    ARG_UNUSED(class_data);
    audio_header[8] = midi_streaming.bInterfaceNumber;
    return 0;
}

static void *midi_get_desc(struct usbd_class_data *class_data, enum usbd_speed speed)
{
    ARG_UNUSED(class_data);
    return speed == USBD_SPEED_FS ? midi_descriptors : NULL;
}

static const struct usbd_class_api midi_api = {
    .request = midi_request,
    .enable = midi_enable,
    .disable = midi_disable,
    .suspended = midi_disable,
    .resumed = midi_enable,
    .feature_halt = midi_halt,
    .init = midi_init,
    .get_desc = midi_get_desc,
};
USBD_DEFINE_CLASS(sp66_midi, &midi_api, NULL, NULL);

/* Use the existing Zephyr development VID/PID, with a new device revision
 * for the composite interface layout. This is independent of the bootloader. */
USBD_DEVICE_DEFINE(sp66_usb, DEVICE_DT_GET(DT_NODELABEL(zephyr_udc0)), 0x2fe3, 0x0004);
USBD_DESC_LANG_DEFINE(sp66_lang);
USBD_DESC_MANUFACTURER_DEFINE(sp66_manufacturer, "SP-66");
USBD_DESC_PRODUCT_DEFINE(sp66_product, "SP-66");
USBD_DESC_SERIAL_NUMBER_DEFINE(sp66_serial);
USBD_CONFIGURATION_DEFINE(sp66_config, USB_SCD_SELF_POWERED, 125, NULL);

static void usb_message(struct usbd_context *context, const struct usbd_msg *message)
{
    ARG_UNUSED(context);
    if (message->type == USBD_MSG_VBUS_REMOVED)
        midi_disable(NULL);
}

int sp1_usb_start(void)
{
    struct usbd_desc_node *const descriptors[] = {
        &sp66_lang, &sp66_manufacturer, &sp66_product, &sp66_serial,
    };
    int rc;
    for (size_t i = 0; i < ARRAY_SIZE(descriptors); ++i) {
        rc = usbd_add_descriptor(&sp66_usb, descriptors[i]);
        if (rc != 0)
            return rc;
    }
    rc = usbd_add_configuration(&sp66_usb, USBD_SPEED_FS, &sp66_config);
    if (rc == 0)
        rc = usbd_register_class(&sp66_usb, "cdc_acm_0", USBD_SPEED_FS, 1);
    if (rc == 0)
        rc = usbd_register_class(&sp66_usb, "sp66_midi", USBD_SPEED_FS, 1);
    if (rc == 0)
        rc = usbd_device_set_bcd_device(&sp66_usb, 0x0101);
    if (rc == 0)
        rc = usbd_msg_register_cb(&sp66_usb, usb_message);
    if (rc == 0)
        rc = usbd_init(&sp66_usb);
    if (rc == 0)
        rc = usbd_enable(&sp66_usb);
    return rc;
}

void sp1_midi_poll(Tr66Sequencer *seq, bool audio_ready)
{
    ReceivedMidi message;
    for (unsigned i = 0; i < QUEUE_DEPTH; ++i) {
        if (k_msgq_get(&midi_events, &message, K_NO_WAIT) != 0)
            break;
        if (message.event.status == TR66_MIDI_NONE)
            tr66_seq_midi_disconnect(seq);
        else if (audio_ready)
            tr66_seq_midi_event(seq, message.event, message.received_ms);
    }
    tr66_seq_midi_poll(seq, k_uptime_get_32());
}
```

## src/usb_midi.h
```c
#ifndef SP66_USB_MIDI_H
#define SP66_USB_MIDI_H

#include "sequencer.h"

int sp1_usb_start(void);
void sp1_midi_poll(Tr66Sequencer *seq, bool audio_ready);

#endif
```
